## yocto/raspberry_pi/bsp/build-rpi-ess/conf/bblayers.conf
```bitbake
# POKY_BBLAYERS_CONF_VERSION is increased each time build/conf/bblayers.conf
# changes incompatibly
POKY_BBLAYERS_CONF_VERSION = "2"

BBPATH = "${TOPDIR}"
BBFILES ?= ""

BBLAYERS ?= " \
  /workdir/bsp/sources/poky/meta \
  /workdir/bsp/sources/poky/meta-poky \
  /workdir/bsp/sources/poky/meta-yocto-bsp \
  /workdir/bsp/sources/meta-raspberrypi \
  /workdir/bsp/sources/meta-openembedded/meta-oe \
  /workdir/bsp/sources/meta-openembedded/meta-python \
  /workdir/bsp/sources/meta-ess \
  /workdir/bsp/sources/meta-qt5 \
  "
```

## yocto/raspberry_pi/bsp/sources/meta-ess/conf/distro/ess-distro.conf
```bitbake
DISTRO = "ess"
DISTRO_NAME = "ess (Yocto ess Distro based off kirkstone 4.0.4 Distro)"

# based of poky conf
require conf/distro/poky.conf

# recipe specific maintainers
include conf/distro/include/ess-maintainers.inc

DISTRO_VERSION = "1.0.0"
DISTRO_CODENAME = "ess"
SDK_VENDOR = "-esssdk"
SDK_VERSION = "${@d.getVar('DISTRO_VERSION').replace('snapshot-${METADATA_REVISION}', 'snapshot')}"
SDK_VERSION[vardepvalue] = "${SDK_VERSION}"

MAINTAINER = "ess <xyz@gmain.com>"

# select systemd to replace sysv daemon manager and logger
DISTRO_FEATURES:append = " systemd resolved"
VIRTUAL-RUNTIME_init_manager = "systemd"

# wifi credentials
DISTRO_FEATURES:append = " wpa_supplicant"

# remove unnecessay packages
# one of 'x11 wayland' needs to be in DISTRO_FEATURES for some gstreamer items
DISTRO_FEATURES:remove = "pcmcia"
DISTRO_FEATURES:remove = "wayland"
#DISTRO_FEATURES:remove = "x11"

# default timezone
DEFAULT_TIMEZONE = "America/Los_Angeles"

# enable the optional-feature feature of ess-canonical-app which installs ess-optional-feature package
# could just explicity set the features
# PACKAGECONFIG:pn-ess-canonical-app = " optional-feature"
# or append feature
PACKAGECONFIG:append:pn-ess-canonical-app = " optional-feature"
```

## yocto/raspberry_pi/bsp/sources/meta-ess/conf/distro/include/ess-maintainers.inc
```bitbake
# Yocto Project / OpenEmbedded-Core (OE-Core) Maintainers File
#
# This file contains a list of recipe maintainers.
#
# Please submit any patches against recipes in meta to the
# OE-Core mail list (openembedded-core@lists.openembedded.org)
# For recipes in meta-yocto please use the Poky list (poky@lists.yoctoproject.org)
#
# If you have problems with or questions about a particular recipe, feel
# free to contact the maintainer directly (cc:ing the appropriate mailing list
# puts it in the archive and helps other people who might have the same
# questions in the future), but please try to do the following first:
#
#  - look in the Yocto Project Bugzilla
#    (http://bugzilla.yoctoproject.org/) to see if a problem has
#    already been reported
#
# - look through recent entries of the appropriate mailing list archives
#   (http://lists.linuxtogo.org/pipermail/openembedded-core or
#    https://lists.yoctoproject.org/pipermail/poky/) to see if other
#   people have run into similar problems or had similar questions
#   answered.
#
# The format is as a bitbake variable override for each recipe
#
#	RECIPE_MAINTAINER:pn-<recipe name> = "Full Name <address@domain>"
#
# Please keep this list in alphabetical order.
#
RECIPE_MAINTAINER:pn-ess-image = "ess <xyz@gmail.com>"
```

## yocto/raspberry_pi/bsp/sources/meta-ess/conf/layer.conf
```bitbake
# We have a conf and classes directory, add to BBPATH
BBPATH .= ":${LAYERDIR}"

# We have recipes-* directories, add to BBFILES
BBFILES += "${LAYERDIR}/recipes-*/*/*.bb \
            ${LAYERDIR}/recipes-*/*/*.bbappend"

BBFILE_COLLECTIONS += "meta-ess"
BBFILE_PATTERN_meta-ess = "^${LAYERDIR}/"
# lowest priority ensures these recipes are applied after other layers (if same recipes exist in other layers)
BBFILE_PRIORITY_meta-ess = "4"

LAYERDEPENDS_meta-ess = "core"
LAYERSERIES_COMPAT_meta-ess = "kirkstone"
```

## yocto/raspberry_pi/bsp/sources/meta-ess/conf/machine/raspberrypi4-64-ess.conf
```bitbake
#@TYPE: ess Machine (started from raspberrypi4-64.conf)
#@NAME: RaspberryPi 4 Development Board (64bit)
#@DESCRIPTION: Machine configuration for the RaspberryPi 4 in 64 bits mode

# override the default /etc/hostname (machine name by default)
hostname:pn-base-files = "ess-hostname"

MACHINEOVERRIDES = "raspberrypi4:${MACHINE}"

MACHINE_FEATURES += "pci"
MACHINE_EXTRA_RRECOMMENDS += "\
    linux-firmware-rpidistro-bcm43455 \
    bluez-firmware-rpidistro-bcm4345c0-hcd \
    linux-firmware-rpidistro-bcm43456 \
    bluez-firmware-rpidistro-bcm4345c5-hcd \
"

DEFAULTTUNE = "cortexa72"

require conf/machine/include/arm/armv8a/tune-cortexa72.inc
include conf/machine/include/rpi-base.inc

RPI_KERNEL_DEVICETREE = " \
    broadcom/bcm2711-rpi-4-b.dtb \
    broadcom/bcm2711-rpi-400.dtb \
    broadcom/bcm2711-rpi-cm4.dtb \
"

SDIMG_KERNELIMAGE ?= "kernel8.img"
SERIAL_CONSOLES ?= "115200;ttyS0"

UBOOT_MACHINE = "rpi_arm64_config"

VC4DTBO ?= "vc4-kms-v3d"

# When u-boot is enabled we need to use the "Image" format and the "booti"
# command to load the kernel
KERNEL_IMAGETYPE_UBOOT ?= "Image"
# "zImage" not supported on arm64 and ".gz" images not supported by bootloader yet
KERNEL_IMAGETYPE_DIRECT ?= "Image"
KERNEL_BOOTCMD ?= "booti"

ARMSTUB ?= "armstub8-gic.bin"

# enable debug uart
ENABLE_UART = "1"

# enable spi-dev nodes
ENABLE_SPI_BUS = "1"

# enable i2c-dev nodes
ENABLE_I2C = "1"
# auto-load I2C kernel modules
KERNEL_MODULE_AUTOLOAD:rpi += "i2c-dev"
# i2c-bcm2708 may be the low level driver
#  ... 2708 was the rp1 core, POP'd with DDR became 2835
#  ... 2709 was the rp2 core, POP'd with DDR became 2836
#  ... 2710 was the rp3 core, POP'd with DDR became 2837
#  ... xxxx was the rp4 core, POP'd with DDR became 2711
#  ... review later if needed for actual user space writes
#  ... i see a /sys/module/i2c_bcm2835, 2835 is the rp1 POP'd 2711
#KERNEL_MODULE_AUTOLOAD:rpi += "i2c-dev i2c-bcm2708"

# ess-image.bb specifies ovelayfs-etc IMAGE_FEATURES
#   creates /etc overlayfs in specified mount
#   requires ext4 sd card parition for rw /etc data
OVERLAYFS_ETC_MOUNT_POINT ?= "/data"
OVERLAYFS_ETC_FSTYPE ?= "ext4"
OVERLAYFS_ETC_DEVICE ?= "/dev/mmcblk0p3"

# bsp version installed in and autoloads during kernel init
KERNEL_MODULE_AUTOLOAD += "bsp-version"
```
